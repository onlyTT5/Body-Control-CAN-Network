#include "bsp_encoder.h"
#include "tim.h"

/*
 * TIM2 encoder interface:
 *   PA0 -> channel A / TIM2_CH1
 *   PA1 -> channel B / TIM2_CH2
 *
 * GPIO and timer parameters are generated by CubeMX in tim.c.  This driver
 * only starts the HAL encoder interface and converts counter changes to
 * application events.
 */
#define BSP_ENCODER_DIRECTION_REVERSED 0U
#define BSP_ENCODER_COUNTS_PER_DETENT   4

static uint16_t s_last_counter;
static int16_t s_count_accumulator;
static int32_t s_position;

void BspEncoder_Init(void)
{
    if(HAL_TIM_Encoder_Start(&htim2, TIM_CHANNEL_ALL) != HAL_OK)
    {
        Error_Handler();
    }

    __HAL_TIM_SET_COUNTER(&htim2, 0x8000U);
    s_last_counter = (uint16_t)__HAL_TIM_GET_COUNTER(&htim2);
    s_count_accumulator = 0;
    s_position = 0;
}

BspEncoderEvent BspEncoder_Poll(void)
{
    uint16_t current_counter;
    int16_t delta;

    current_counter = (uint16_t)__HAL_TIM_GET_COUNTER(&htim2);
    delta = (int16_t)(current_counter - s_last_counter);

    s_last_counter = current_counter;

#if BSP_ENCODER_DIRECTION_REVERSED
    delta = (int16_t)(-delta);
#endif

    s_count_accumulator = (int16_t)(s_count_accumulator + delta);

    if(s_count_accumulator >= BSP_ENCODER_COUNTS_PER_DETENT)
    {
        s_count_accumulator = (int16_t)(s_count_accumulator -
                              BSP_ENCODER_COUNTS_PER_DETENT);
        s_position++;
        return BSP_ENCODER_EVENT_CLOCKWISE;
    }

    if(s_count_accumulator <= -BSP_ENCODER_COUNTS_PER_DETENT)
    {
        s_count_accumulator = (int16_t)(s_count_accumulator +
                              BSP_ENCODER_COUNTS_PER_DETENT);
        s_position--;
        return BSP_ENCODER_EVENT_COUNTERCLOCKWISE;
    }

    return BSP_ENCODER_EVENT_NONE;
}

int32_t BspEncoder_GetPosition(void)
{
    return s_position;
}
